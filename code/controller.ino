#include <PCM.h>
#include <avr/sleep.h>
#include <avr/interrupt.h>


      

long unsigned int lowIn;         

long unsigned int pause = 3000;

boolean lockLow = true;
boolean takeLowTime;  

const uint8_t PotPin   = A5;   // Potentiometer
int speakPin = 11;
int pirPin = 2;    //the digital pin connected to the PIR sensor's output
int ledPin = 13;
int counterstart = 0;
int counter = counterstart;
boolean trig;
int tmDelay;

const unsigned char chirp1[] PROGMEM = {
129, 128, 128, 129, 128, 127, 127, 128, 129, 127, 127, 128,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 128, 
};
const unsigned char chirp2[] PROGMEM = {
129, 128, 127, 127, 127, 129, 129, 129, 127, 126, 127, 128,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 128, 
};
const unsigned char chirp3[] PROGMEM = {
129, 129, 128, 127, 127, 127, 128, 129, 129, 128, 127, 126,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 128, 
};
const unsigned char chirp4[] PROGMEM = {
129, 129, 129, 129, 128, 128, 128, 128, 128, 128, 127, 127,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 128, 
};
const unsigned char chirp5[] PROGMEM = {
129, 128, 128, 128, 128, 127, 127, 128, 128, 129, 128, 128,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 128, 
};


void playTone(uint16_t tone1, uint16_t duration)
{
  for (long i = 0; i < duration * 1000L; i += tone1 * 2) {
     digitalWrite(speakPin, HIGH);
     delayMicroseconds(tone1);
     digitalWrite(speakPin, LOW);
     delayMicroseconds(tone1);
  }  
} 

void wakeUp(void)
{
    sleep_disable ();  
}



void playchirp1(){
  delay(50);
  startPlayback(chirp1, sizeof(chirp1));
  delay(random(500, 1500));}
  
void playchirp2(){
  delay(50);
  startPlayback(chirp2, sizeof(chirp2));
  delay(random(500, 1500));}
  
void playchirp3(){
  delay(50);
  startPlayback(chirp3, sizeof(chirp3));
  delay(random(500, 1500));}
  
void playchirp4(){
  delay(50);
  startPlayback(chirp4, sizeof(chirp4));
  delay(random(500, 1500));}
  
void playchirp5(){
  delay(50);
  startPlayback(chirp5, sizeof(chirp5));
  delay(random(500, 1500));}

void (*functionPtr[])() = {playchirp1,playchirp2,playchirp3,playchirp4,playchirp5};

void RandChirps(){
  functionPtr[random(0, 4)]();       // Call a function in random sequence
  delay(10);
  functionPtr[random(0, 4)]();       // Call a function in random sequence
  delay(10);
  functionPtr[random(0, 4)]();       // Call a function in random sequence
  delay(10);
  functionPtr[random(0, 4)]();       // Call a function in random sequence
  delay(100);
  stopPlayback();
  delay(200);
}

///sleeper code with interupt
void sleepNow()
{
    //Serial.println("Entering Sleep");
    // Set pin 2 as interrupt and attach handler:
      set_sleep_mode (SLEEP_MODE_PWR_DOWN);   
      noInterrupts ();          // make sure we don't get interrupted before we sleep
      sleep_enable ();          // enables the sleep bit in the mcucr register
      EIFR = bit (INTF0);       // clear flag for interrupt 0
      attachInterrupt (0, wakeUp, RISING);  // wake up on rising edge
      interrupts ();           // interrupts allowed now, next instruction WILL be executed
      sleep_cpu ();            // here the device is put to sleep
      detachInterrupt (0);      // stop this interrupt until next time
}



void trigger()
{ int valPot  = analogRead(PotPin);
  unsigned long   tmDelay = map(valPot, 0L, 1023L, 100L, 9000L);
  delay(tmDelay);
  RandChirps();
}

/////////////////////////////
//SETUP
void setup()
{
  Serial.begin(9600);
  randomSeed(analogRead(0));

  

  
  pinMode(pirPin, INPUT);
  pinMode(ledPin, OUTPUT);
  pinMode(speakPin, OUTPUT);
  digitalWrite(pirPin, LOW);

  //give the sensor some time to calibrate
    digitalWrite(ledPin,HIGH);
    playTone(400,100);
    playTone(600,100);
   delay(4000);

   digitalWrite(pirPin, LOW);
   delay(200);
   for(int i = 0; i < 5; i++){
      playTone(50,5);
      delay(1000);
      }
    delay(100);
    digitalWrite(ledPin,LOW);
    playTone(600,100);
    playTone(400,100);

 }

////////////////////////////
//LOOP
void loop()
{
    digitalWrite(ledPin, LOW);
    delay(10);
    
    if(digitalRead(pirPin) == HIGH)
       {counter = counter + 1;
        trig = true;
        digitalWrite(ledPin, HIGH);
        delay(10);
        if(counter > 100){
           counter = counterstart;
           trigger();}
     }
        
     else
        {counter = counter - 1;
         trig = false;
         digitalWrite(ledPin,LOW);
         delay(10);
         if(counter < 0){
            playTone(20,1);
            counter = counterstart;
            digitalWrite(ledPin,LOW);
            digitalWrite(pirPin, LOW);
            sleepNow();
            } 
         } 
 }
